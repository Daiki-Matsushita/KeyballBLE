## config/west.yml
```yaml
manifest:
  remotes:
    - name: zmkfirmware
      url_base: https://github.com/zmkfirmware
    - name: Dist16384
      url_base: https://github.com/Dist16384
  projects:
    - name: zmk
      remote: zmkfirmware
      revision: 2e8d93c788554868424269e38f42018260655d8f
      import: app/west.yml
    - name: zmk-pmw3610-driver
      remote: Dist16384
      revision: main
  self:
    path: config
```
